## boards/shields/forager/Kconfig.defconfig
```kconfig
if SHIELD_FORAGER_LEFT

config ZMK_KEYBOARD_NAME
    default "Forager"

config ZMK_SPLIT_ROLE_CENTRAL
    default y

config ZMK_STUDIO
    default y

endif

if SHIELD_FORAGER_LEFT || SHIELD_FORAGER_RIGHT

config ZMK_SPLIT
    default y

endif
```

## boards/shields/forager/Kconfig.shield
```kconfig
config SHIELD_FORAGER_LEFT
    def_bool $(shields_list_contains,forager_left)

config SHIELD_FORAGER_RIGHT
    def_bool $(shields_list_contains,forager_right)
```
